// File generated 17/09/2023 12:32:51 AM
// Warning! This is a generated file, any manual changes will be
// lost during the next generation.

#constant  IFONT_OFFSET     0
// object indexes into ImageControl
#CONST
    iForm0          // offset 0x0
    iUserbutton0    // offset 0xBBA00
    iForm1          // offset 0xC0200
    iUserbutton1    // offset 0x17BC00
    iUserbutton2    // offset 0x18A600
    iUserbutton3    // offset 0x199000
    iUserbutton4    // offset 0x19D800
    iUserbutton5    // offset 0x1AC200
    iForm2          // offset 0x1BAC00
    iUserbutton6    // offset 0x276600
    iUserbutton10   // offset 0x29B200
    iUserbutton11   // offset 0x29FA00
    iUserbutton12   // offset 0x2A4800
    iUserbutton13   // offset 0x2A9000
    iUserbutton14   // offset 0x2AD800
    iForm3          // offset 0x2B2000
    iUserbutton7    // offset 0x36DA00
    iUserbutton8    // offset 0x370200
    iCustomdigits0  // offset 0x394E00
    iiCustomdigits0 // offset 0x399600
    iCustomdigits1  // offset 0x3AFA00
    iiCustomdigits1 // offset 0x3B4200
    iCustomdigits2  // offset 0x3CA600
    iiCustomdigits2 // offset 0x3CEE00
    iUserbutton9    // offset 0x3E5200
    iGauge0         // offset 0x409E00
    iGauge1         // offset 0x6A3C00
    iGauge2         // offset 0x93DA00
    iGauge3         // offset 0xBD7800
    iGauge4         // offset 0xE71600
    iGauge5         // offset 0x110B400
    iForm4          // offset 0x13A5200
    iUserbutton30   // offset 0x1460C00
    iUserbutton31   // offset 0x1465400
    iUserbutton32   // offset 0x1469C00
    iUserbutton33   // offset 0x146E400
    iUserbutton34   // offset 0x1472C00
    iForm5          // offset 0x1477400
    iUserbutton15   // offset 0x1532E00
    iUserbutton16   // offset 0x1537600
    iUserbutton17   // offset 0x153C400
    iUserbutton18   // offset 0x1540C00
    iUserbutton19   // offset 0x1545400
    iForm6          // offset 0x1549C00
    iUserbutton20   // offset 0x1605600
    iUserbutton21   // offset 0x1609E00
    iUserbutton22   // offset 0x160EC00
    iUserbutton23   // offset 0x1613400
    iUserbutton24   // offset 0x1617C00
    iForm7          // offset 0x161C400
    iUserbutton25   // offset 0x16D7E00
    iUserbutton26   // offset 0x16DC600
    iUserbutton27   // offset 0x16E1400
    iUserbutton28   // offset 0x16E5C00
    iUserbutton29   // offset 0x16EA400
#END



#IFNOT EXISTS NOGLOBALS
var hndl ;
#ENDIF
