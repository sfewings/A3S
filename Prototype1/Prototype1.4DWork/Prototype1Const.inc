// File generated 2/08/2023 9:11:10 PM
// Warning! This is a generated file, any manual changes will be
// lost during the next generation.

#constant  IFONT_OFFSET     0
// object indexes into ImageControl
#CONST
    iForm0          // offset 0x0
    iGauge0         // offset 0xBBA00
    iGauge1         // offset 0x294A00
    iGauge2         // offset 0x46DA00
    iGauge3         // offset 0x646A00
    i4Dbutton0      // offset 0x81FA00
    iCustomdigits0  // offset 0x82DC00
    iiCustomdigits0 // offset 0x832400
    iCustomdigits1  // offset 0x848800
    iiCustomdigits1 // offset 0x84D000
    iCustomdigits2  // offset 0x863400
    iiCustomdigits2 // offset 0x867C00
#END



#IFNOT EXISTS NOGLOBALS
var hndl ;
#ENDIF
